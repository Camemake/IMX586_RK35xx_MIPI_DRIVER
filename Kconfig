## Kconfig
```kconfig
config VIDEO_IMX586
	tristate "Sony IMX586 CMOS sensor"
	depends on I2C && VIDEO_V4L2 && MEDIA_CAMERA_SUPPORT
	select VIDEO_V4L2_SUBDEV_API
	select REGMAP_I2C
	help
	  V4L2 sub‑device driver for the 48‑megapixel Sony IMX586 image sensor
	  connected to the Raspberry Pi 5 RP1 Unicam controller using four
	  MIPI‑CSI2 data lanes.
```
